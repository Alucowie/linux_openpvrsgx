## drivers/gpu/drm/powervrsgx/Kconfig
```kconfig
# SPDX-License-Identifier: GPL-2.0

config DRM_POWERVRSGX
	tristate "PowerVR SGX (DRM support for PowerVR Serie 5 SGX GPUs)"
	depends on ARM || COMPILE_TEST
	depends on DRM
	depends on MMU
	depends on PM
	select DRM_EXEC
	select DRM_GEM_SHMEM_HELPER
	select DRM_SCHED
	select DRM_GPUVM
	select FW_LOADER
	help
	  DRM driver for PowerVR Serie 5 SGX GPUs.
```

## drivers/gpu/drm/rewopsgx/Kconfig
```kconfig
# SPDX-License-Identifier: GPL-2.0

config DRM_REWOPSGX
	tristate "RewopSGX (DRM support for PowerVR Series5 SGX GPUs)"
	depends on DRM
	depends on ARM || COMPILE_TEST
	depends on MMU
	select DRM_SCHED
	select DRM_GEM_SHMEM_HELPER
	help
	  DRM driver for PowerVR Series5 (SGX5xx) GPUs.
```
